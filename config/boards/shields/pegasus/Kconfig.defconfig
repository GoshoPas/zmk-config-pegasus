## config/boards/shields/pegasus/Kconfig.defconfig
```kconfig
if SHIELD_PEGASUS_LEFT

config ZMK_KEYBOARD_NAME
    default "Pegasus"

config ZMK_SPLIT_ROLE_CENTRAL
    default y

endif

if SHIELD_PEGASUS_LEFT || SHIELD_PEGASUS_RIGHT

config ZMK_SPLIT
    default y

endif
```

## config/boards/shields/pegasus/Kconfig.shield
```kconfig
config SHIELD_PEGASUS_LEFT
    def_bool $(shields_list_contains,pegasus_left)

config SHIELD_PEGASUS_RIGHT
    def_bool $(shields_list_contains,pegasus_right)
```

## config/west.yml
```yaml
manifest:
  remotes:
    - name: zmkfirmware
      url-base: https://github.com/zmkfirmware
    - name: custom
      url-base: https://github.com/GoshoPas  # or your GitHub org

  projects:
    - name: zmk
      remote: zmkfirmware
      revision: main
      import: app/west.yml

    - name: zmk-config-pegasus
      remote: custom
      revision: main  # or a tag/commit/branch

  self:
    path: config
```
